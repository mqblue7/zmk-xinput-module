## Kconfig
```kconfig
config ZMK_XINPUT
    bool "ZMK XInput USB Gamepad Support"
    depends on ZMK_USB
    select USB_DEVICE_STACK
    help
      Enables an additional USB interface that presents as an Xbox 360
      (XInput) compatible gamepad alongside the standard HID keyboard.

if ZMK_XINPUT

config ZMK_XINPUT_LOG_LEVEL
    int "ZMK XInput Log Level"
    default 0

endif # ZMK_XINPUT
```

## config/boards/shields/twobutton/Kconfig.defconfig
```kconfig
if SHIELD_TWOBUTTON

config ZMK_KEYBOARD_NAME
    default "TwoButton XInput"

endif
```

## config/boards/weact_mini_f411ce/Kconfig.defconfig
```kconfig
if BOARD_WEACT_MINI_F411CE

config ZMK_KEYBOARD_NAME
	default "WeAct MiniF4"

config USB_DEVICE_MANUFACTURER
	default "WeAct Studio"

config USB_DEVICE_PRODUCT
	default "WeAct MiniF4"

config USB_DEVICE_VID
	default 0x1D50

config USB_DEVICE_PID
	default 0x615E

endif # BOARD_WEACT_MINI_F411CE
```

## config/boards/weact_mini_f411ce/board.yml
```yaml
board:
  name: weact_mini_f411ce
  full_name: WeAct Studio MiniF4 STM32F411CE
  vendor: weact
  variants:
    - name: blackpill
      qualifier: blackpill
      socs:
        - name: stm32f411ce
```

## config/boards/weact_mini_f411ce/weact_mini_f411ce_defconfig
```kconfig
CONFIG_SOC_SERIES_STM32F4X=y
CONFIG_SOC_STM32F411XE=y
CONFIG_BOARD_WEACT_MINI_F411CE=y

# ARM Cortex-M4F
CONFIG_CPU_CORTEX_M4=y

# Enable FPU
CONFIG_FPU=y
CONFIG_FPU_SHARING=y

# Clock
CONFIG_CLOCK_STM32_HSE_CLOCK=25000000
CONFIG_CLOCK_STM32_SYSCLK_SRC_PLL=y
CONFIG_CLOCK_STM32_PLL_SRC_HSE=y
CONFIG_CLOCK_STM32_PLL_M_DIVISOR=25
CONFIG_CLOCK_STM32_PLL_N_MULTIPLIER=192
CONFIG_CLOCK_STM32_PLL_P_DIVISOR=2
CONFIG_CLOCK_STM32_AHB_PRESCALER=1
CONFIG_CLOCK_STM32_APB1_PRESCALER=2
CONFIG_CLOCK_STM32_APB2_PRESCALER=1

# USB
CONFIG_USB_DEVICE_DRIVER=y

# GPIO
CONFIG_GPIO=y

# Console disabled (USB CDC used instead)
CONFIG_UART_CONSOLE=n
```

## config/west.yml
```yaml
manifest:
  remotes:
    - name: zmkfirmware
      url-base: https://github.com/zmkfirmware

    - name: xinput-remote
      url-base: https://github.com/mqblue7

  projects:
    - name: zmk
      remote: zmkfirmware
      revision: main
      import: app/west.yml

- name: zmk-xinput
      remote: xinput-remote
      revision: main        # ← was master, now main

  self:
    path: config
```

## dts/bindings/behaviors/zmk,behavior-xinput.yaml
```yaml
description: ZMK XInput Gamepad Button Behavior

compatible: "zmk,behavior-xinput"

include: one_param.yaml
```
