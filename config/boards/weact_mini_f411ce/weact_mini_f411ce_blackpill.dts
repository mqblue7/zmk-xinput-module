/*
 * Copyright (c) 2022 The ZMK Contributors
 * SPDX-License-Identifier: MIT
 *
 * Blackpill variant: adds the ZMK blackpill interconnect nexus,
 * allowing shields to reference pins via &blackpill <pin_num>.
 *
 * Pin numbering follows ZMK blackpill convention (blue labels):
 *   0  = B12   1  = B13   2  = B14   3  = B15
 *   4  = A8    5  = A9    6  = A10   7  = A11
 *   8  = A12   9  = A15  10  = B3   11  = B4
 *  12  = B5   13  = B6   14  = B7   15  = B8
 *  16  = B9   17  = C13  18  = C14  19  = C15
 *  20  = A0   21  = A1   22  = A2   23  = A3
 *  24  = A4   25  = A5   26  = A6   27  = A7
 *  28  = B0   29  = B1   30  = B10  31  = B2
 *  32  = B11
 */

#include "weact_mini_f411ce.dts"

/ {
	blackpill: connector {
		compatible = "weact-studio,blackpill";
		#gpio-cells = <2>;
		gpio-map-mask = <0xffffffff 0xffffffc0>;
		gpio-map-pass-thru = <0 0x3f>;
		gpio-map
			= <0  0 &gpiob 12 0>
			, <1  0 &gpiob 13 0>
			, <2  0 &gpiob 14 0>
			, <3  0 &gpiob 15 0>
			, <4  0 &gpioa  8 0>
			, <5  0 &gpioa  9 0>
			, <6  0 &gpioa 10 0>
			, <7  0 &gpioa 11 0>
			, <8  0 &gpioa 12 0>
			, <9  0 &gpioa 15 0>
			, <10 0 &gpiob  3 0>
			, <11 0 &gpiob  4 0>
			, <12 0 &gpiob  5 0>
			, <13 0 &gpiob  6 0>
			, <14 0 &gpiob  7 0>
			, <15 0 &gpiob  8 0>
			, <16 0 &gpiob  9 0>
			, <17 0 &gpioc 13 0>
			, <18 0 &gpioc 14 0>
			, <19 0 &gpioc 15 0>
			, <20 0 &gpioa  0 0>
			, <21 0 &gpioa  1 0>
			, <22 0 &gpioa  2 0>
			, <23 0 &gpioa  3 0>
			, <24 0 &gpioa  4 0>
			, <25 0 &gpioa  5 0>
			, <26 0 &gpioa  6 0>
			, <27 0 &gpioa  7 0>
			, <28 0 &gpiob  0 0>
			, <29 0 &gpiob  1 0>
			, <30 0 &gpiob 10 0>
			, <31 0 &gpiob  2 0>
			, <32 0 &gpiob 11 0>
			;
	};
};
