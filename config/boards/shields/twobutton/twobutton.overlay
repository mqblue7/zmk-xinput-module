/ {
    chosen {
        zmk,kscan = &kscan0;
    };

    kscan0: kscan {
        compatible = "zmk,kscan-gpio-direct";
        wakeup-source;
        input-gpios
            = <&gpioa 1 (GPIO_ACTIVE_LOW | GPIO_PULL_UP)>
            , <&gpioa 2 (GPIO_ACTIVE_LOW | GPIO_PULL_UP)>
            ;
    };
};
